/*
 * Copyright (c) 2023 Antmicro <www.antmicro.com>
 *
 * SPDX-License-Identifier: Apache-2.0
 */

 / {
	resources {
		compatible = "test-gpio-basic-api";
		out-gpios = <&gpioa 12 0>;
		in-gpios = <&gpioa 13 0>;
	};
};
