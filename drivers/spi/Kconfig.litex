## drivers/spi/Kconfig.litex
```kconfig
# Copyright (c) 2020 Antmicro <www.antmicro.com>
# SPDX-License-Identifier: Apache-2.0

config SPI_LITESPI
	bool "LiteX SPI controller driver"
	depends on SOC_RISCV32_LITEX_VEXRISCV
	help
	  Enable the SPI peripherals on LiteX

#if SPI_LITEX

menuconfig SPI_FLASH_LITEX
	bool "LiteX SPI flash driver"
	depends on SOC_RISCV32_LITEX_VEXRISCV
	select SPI_FLASH
	select HAS_DTS_SPI	
	default n
	help
	  Enable Quad SPI flash support

config SPI_FLASH_LITEX_DRV_NAME
	string "SPI flash device name"
	default "SPI_FLASH_LITEX"
```

## drivers/timer/Kconfig.ambiq
```kconfig
# SPDX-License-Identifier: Apache-2.0
#
# Copyright (c) 2023 Antmicro <www.antmicro.com>

config AMBIQ_STIMER_TIMER
	bool "Ambiq STIMER system clock driver"
	default y
	depends on DT_HAS_AMBIQ_STIMER_ENABLED
	depends on HAS_AMBIQ_HAL
	select TICKLESS_CAPABLE
	select AMBIQ_HAL_USE_STIMER
	help
	  If you enable this, STIMER will be used to provide hw_cycles and
	  kernel ticks instead of Cortex-M SysTick.

	  If unsure, say 'N'.
```

## dts/bindings/clock/ambiq,clock.yaml
```yaml
# Copyright (c) 2023 Ambiq Micro Inc. <www.ambiq.com>
# SPDX-License-Identifier: Apache-2.0

description: Ambiq Clock Control

compatible: "ambiq,clock"

include: [clock-controller.yaml, pinctrl-device.yaml, base.yaml]

properties:
  clock-frequency:
    type: int
    description: output clock frequency (Hz)
    required: true

  pinctrl-0:
    required: true

  pinctrl-names:
    required: true

  "#clock-cells":
    const: 1
```

## dts/bindings/dma/litex,fastvdma.yaml
```yaml
#
# Copyright (c) 2021 Antmicro <www.antmicro.com>
#
# SPDX-License-Identifier: Apache-2.0
#

description: Litex FastVDMA

include: base.yaml

compatible: "litex,fastvdma"

bus: dma

properties:
    label:
      required: true

    reg:
      required: true

    interrupts:
      required: true
```

## dts/bindings/gpio/nxp,pcf8574.yaml
```yaml
# Copyright (c) 2021 Antmicro
# SPDX-License-Identifier: Apache-2.0

description: PCF8574 series I2C-based GPIO expander

compatible: "nxp,pcf8574"

include: [gpio-controller.yaml, i2c-device.yaml]

properties:
    label:
      required: true

    "#gpio-cells":
      const: 2

    ngpios:
      required: true
      const: 8
      description: |
        Number of GPIOs available on port expander.

    nint-gpios:
      type: phandle-array
      required: false
      description: |
        Connection for the NINT signal. This signal is active-low when
        produced by pcf8574 GPIO node.

gpio-cells:
  - pin
  - flags
```

## dts/bindings/gpio/quicklogic,eos-s3-gpio.yaml
```yaml
description: EOS S3 GPIO node

compatible: "quicklogic,eos-s3-gpio"

include: [gpio-controller.yaml, base.yaml]

properties:
    label:
      required: true

    interrupts:
      required: true

    "#gpio-cells":
      const: 2

    pin-cfgs:
      type: array
      required: true
      description: |
          This property is used to preconfigure the GPIOs and connect them to
          a primary(0) or a secondary(1) pin. EOS S3 supports up to 8 GPIOs
          which can be configured as follows
          "GPIO_NUM : primary_pin_num / secondary_pin_num"
          "0 : 6 / 24"
          "1 : 9 / 26"
          "2 : 11 / 28"
          "3 : 14 / 30"
          "4 : 18 / 31"
          "5 : 21 / 36"
          "6 : 22 / 38"
          "7 : 23 / 45"
          E.g. configuring GPIO 2 as secondary results in controlling pin 28,
          to do so set the value to 1 on the index 2 of this property
          "pin-cfgs = <0 0 1 0 0 0 0 0>;"

gpio-cells:
  - pin
  - flags
```

## dts/bindings/i2c/litex,i2c.yaml
```yaml
#
# Copyright (c) 2019 Antmicro <www.antmicro.com>
#
# SPDX-License-Identifier: Apache-2.0
#

title: LiteX I2C

description: >
    This is a binding for the LiteX I2C interface

compatible: "litex,i2c"

include: i2c-controller.yaml

properties:
    reg:
      required: true
```

## dts/bindings/pwm/litex,pwm.yaml
```yaml
#
# Copyright (c) 2019 Antmicro <www.antmicro.com>
#
# SPDX-License-Identifier: Apache-2.0
#

description: LiteX PWM controller

include: [pwm-controller.yaml, base.yaml]

compatible: "litex,pwm"
properties:

    reg:
      required: true

    prescaler:
      default: 1
      type: int
      required: false

    "#pwm-cells":
      const: 1

pwm-cells:
  - channel
```

## dts/bindings/pwm/quicklogic,eos-s3-pwm-gen.yaml
```yaml
description: QuickLogic FPGA IP core PWM

compatible: "quicklogic,eos-s3-pwm-gen"

include: [pwm-controller.yaml, base.yaml]

properties:
    reg:
      required: true

    # Divider set to Sys_Clk0 or Sys_Clk1 used to generate Wishbone clock.
    # Wishbone clock cannot exceed 10MHz. Divider for FPGA clock domain
    # is set in soc.c
    divider:
      type: int
      required: true

    "#pwm-cells":
      const: 1

pwm-cells:
  - channel
```

## dts/bindings/spi/litex,spi_flash.yaml
```yaml
#
# Copyright (c) 2020 Antmicro <www.antmicro.com>
#
# SPDX-License-Identifier: Apache-2.0
#

description: >
    This is a binding for the LiteX Spi Flash interface

include: base.yaml

compatible: "litex,spiflash4x0"


properties:
    reg:
      required: true
  
```

## dts/bindings/spi/quicklogic,eos-s3-spi.yaml
```yaml
# Copyright (c) 2020 Antmicro <www.antmicro.com>
# SPDX-License-Identifier: Apache-2.0

description: QuickLogic SPI controller

compatible: "quicklogic,eos-s3-spi"

include: spi-controller.yaml

properties:
    reg:
      required: true

    interrupts:
      required: true
```

## samples/bluetooth/peripheral/sample.yaml
```yaml
sample:
  name: Bluetooth Peripheral
  description: Demonstrates the BLE Peripheral role
tests:
  sample.bluetooth.peripheral:
    harness: bluetooth
    platform_allow:
      - qemu_x86
      - nucleo_wb55rg
    integration_platforms:
      - qemu_x86
    tags: bluetooth
  sample.bluetooth.peripheral.x_nucleo_idb05a1_shield:
    harness: bluetooth
    platform_allow: nucleo_l4r5zi
    depends_on:
      - arduino_spi
      - arduino_gpio
    extra_args: SHIELD=x_nucleo_idb05a1
    integration_platforms:
      - nucleo_l4r5zi
  sample.bluetooth.peripheral.ambiq:
    harness: bluetooth
    platform_allow: 
      - apollo4p_evb
    extra_args: OVERLAY_CONFIG="ambiq.conf"
    integration_platforms:
      - apollo4p_evb
```

## soc/arm/quicklogic_eos_s3/Kconfig
```kconfig
# Copyright (c) 2020 Antmicro <www.antmicro.com>
# SPDX-License-Identifier: Apache-2.0

config SOC_EOS_S3
	bool

config SOC_EOS_S3_GPIO
       bool
       help
         Set if the General Purpose Input/Output (GPIO) HAL module is used.
```

## soc/riscv/fomu/Kconfig.soc
```kconfig
# Copyright (c) 2022 Antmicro <www.antmicro.com>
# SPDX-License-Identifier: Apache-2.0

config SOC_RISCV32_FOMU
	bool "Fomu system implementation"
	select RISCV
	select ATOMIC_OPERATIONS_C
	select INCLUDE_RESET_VECTOR
```

## soc/riscv/kosagi-fomu/Kconfig.defconfig
```kconfig
# Copyright (c) 2022 Antmicro <www.antmicro.com>
# SPDX-License-Identifier: Apache-2.0

if SOC_RISCV32_KOSAGI_FOMU

config SOC
	default "kosagi-fomu"

config SYS_CLOCK_HW_CYCLES_PER_SEC
	default 12000000

config RISCV_HAS_CPU_IDLE
	bool

config RISCV_HAS_PLIC
	bool

config NUM_IRQS
	default 12

config RISCV_ATOMICS_ISA
	default n

config LITEX_CSR_DATA_WIDTH
	default 8

endif # SOC_RISCV32_KOSAGI_FOMU
```

## subsys/serial_loader/Kconfig
```kconfig
# Serial loader configuration options

# Copyright (c) 2021 Antmicro <www.antmicro.com>
# SPDX-License-Identifier: Apache-2.0

config SERIAL_LOADER_SHELL
	bool "Enable SERIAL_LOADER Shell"
	depends on SHELL
	help
	  Enable SERIAL LOADER Shell.
```

## tests/subsys/cpp/cxx/testcase.yaml
```yaml
common:
    tags: cpp
    toolchain_exclude: xcc
    integration_platforms:
      - mps2_an385
      - qemu_cortex_a53

tests:
  cpp.main.minimal:
    extra_configs:
      - CONFIG_MINIMAL_LIBC=y
  cpp.main.newlib:
    tags: cpp newlib
    filter: TOOLCHAIN_HAS_NEWLIB == 1
    min_ram: 32
    extra_configs:
      - CONFIG_NEWLIB_LIBC=y
  cpp.main.newlib_nano:
    tags: cpp newlib
    filter: TOOLCHAIN_HAS_NEWLIB == 1 and CONFIG_HAS_NEWLIB_LIBC_NANO
    min_ram: 24
    extra_configs:
      - CONFIG_NEWLIB_LIBC=y
      - CONFIG_NEWLIB_LIBC_NANO=y
  cpp.main.picolibc:
    tags: cpp picolibc
    filter: CONFIG_PICOLIBC_SUPPORTED
    extra_configs:
      - CONFIG_PICOLIBC=y
```
