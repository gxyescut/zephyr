## boards/arm/quick_feather/Kconfig.defconfig
```kconfig
# QuickLogic Quick Feather board

# Copyright (c) 2020 Antmicro <www.antmicro.com>
# SPDX-License-Identifier: Apache-2.0

if BOARD_QUICK_FEATHER

config BOARD
	default "quick_feather"

if PWM

config PWM_GEN_EOS_S3
        default y

endif # PWM

endif # BOARD_QUICK_FEATHER
```

## boards/arm/siwg917_brd4325a/Kconfig
```kconfig
# Copyright (c) 2023 Antmicro <www.antmicro.com>
#
# SPDX-License-Identifier: Apache-2.0

if BOARD_SIWG917_BRD4325A

module = BOARD_SIWG917
module-str = Board Control
source "subsys/logging/Kconfig.template.log_config"

endif # BOARD_SIWG917_BRD4325a
```

## boards/arm/siwg917_brd4325a/Kconfig.board
```kconfig
# Copyright (c) 2023 Antmicro <www.antmicro.com>
#
# SPDX-License-Identifier: Apache-2.0

config BOARD_SIWG917_BRD4325A
	bool "Silicon Labs BRD4325A"
	depends on SOC_SERIES_SIWG917
	select SOC_PART_NUMBER_SIWG917M612LGTAA
```

## boards/arm/siwg917_brd4325a/Kconfig.defconfig
```kconfig
# Copyright (c) 2023 Antmicro <www.antmicro.com>
#
# SPDX-License-Identifier: Apache-2.0

if BOARD_SIWG917_BRD4325A

config BOARD
	default "siwg917_brd4325a"

endif # BOARD_SIWG917_BRD4325A
```

## boards/arm/video-booster/Kconfig
```kconfig
if BOARD_VIDEO_BOOSTER

config BOARD_INIT_PRIORITY
	int
	default KERNEL_INIT_PRIORITY_DEFAULT
	depends on GPIO
	help
	  Board initialization priority. This must be bigger than
	  GPIO_GECKO_COMMON_INIT_PRIORITY.

endif # BOARD_VIDEO_BOOSTER
```

## boards/arm/video-booster/Kconfig.board
```kconfig
config BOARD_VIDEO_BOOSTER
	bool "VIDEO_BOOSTER"
	depends on SOC_SERIES_EFM32HG
	select SOC_PART_NUMBER_EFM32HG322F64
```

## boards/arm/video-booster/Kconfig.defconfig
```kconfig
if BOARD_VIDEO_BOOSTER

config BOARD
	default "video_booster"

config CMU_HFXO_FREQ
	default 24000000

config CMU_LFXO_FREQ
	default 32768

if GPIO_GECKO

config GPIO_GECKO_PORTA
	default y

config GPIO_GECKO_PORTB
	default y

config GPIO_GECKO_PORTC
	default y

config GPIO_GECKO_PORTD
	default n

config GPIO_GECKO_PORTE
	default n

config GPIO_GECKO_PORTF
	default y

endif # GPIO_GECKO

endif # BOARD_VIDEO_BOOSTER
```

## boards/riscv/fomu/Kconfig.board
```kconfig
# Copyright (c) 2022 Antmicro <www.antmicro.com>
# SPDX-License-Identifier: Apache-2.0

config BOARD_FOMU
	bool "Kosagi FOMU board with LiteX/VexRiscv CPU"
	depends on SOC_RISCV32_FOMU
```

## boards/riscv/fomu/Kconfig.defconfig
```kconfig
# Copyright (c) 2022 Antmicro <www.antmicro.com>
# SPDX-License-Identifier: Apache-2.0

config BOARD
	default "fomu"
	depends on BOARD_FOMU
```

## boards/riscv/fomu/fomu_defconfig
```kconfig
#
# Copyright (c) 2022 Antmicro <www.antmicro.com>
#
# SPDX-License-Identifier: Apache-2.0
#

CONFIG_BOARD_FOMU=y
CONFIG_SOC_RISCV32_FOMU=y

CONFIG_VEXRISCV_LITEX_IRQ=y
CONFIG_LITEX_TIMER=y

CONFIG_SERIAL=y
CONFIG_UART_LITEUART=y
CONFIG_CONSOLE=y
CONFIG_UART_CONSOLE=y

CONFIG_PRINTK=y
CONFIG_EARLY_CONSOLE=n
CONFIG_BOOT_BANNER=n

CONFIG_XIP=y
```

## boards/riscv/kosagi_fomu/Kconfig.board
```kconfig
# Copyright (c) 2022 Antmicro <www.antmicro.com>
# SPDX-License-Identifier: Apache-2.0

config BOARD_KOSAGI_FOMU
	bool "Kosagi FOMU board with LiteX/VexRiscv CPU"
	depends on SOC_RISCV32_KOSAGI_FOMU
```

## boards/riscv/kosagi_fomu/Kconfig.defconfig
```kconfig
# Copyright (c) 2022 Antmicro <www.antmicro.com>
# SPDX-License-Identifier: Apache-2.0

config BOARD
	default "kosagi_fomu"
	depends on BOARD_KOSAGI_FOMU
```

## boards/riscv/kosagi_fomu/kosagi_fomu_defconfig
```kconfig
#
# Copyright (c) 2022 Antmicro <www.antmicro.com>
#
# SPDX-License-Identifier: Apache-2.0
#

CONFIG_BOARD_KOSAGI_FOMU=y
CONFIG_SOC_RISCV32_KOSAGI_FOMU=y

CONFIG_VEXRISCV_LITEX_IRQ=y
CONFIG_LITEX_TIMER=y

CONFIG_LED=y
CONFIG_FOMU_SBLED=y

CONFIG_XIP=y
```

## boards/riscv/litex_vexriscv/Kconfig.defconfig
```kconfig
# LiteX SPI (LiteSPI) configuration option

# Copyright (c) 2018 - 2020 Antmicro <www.antmicro.com>
# SPDX-License-Identifier: Apache-2.0

if BOARD_LITEX_VEXRISCV

config BOARD
	default "litex_vexriscv"

endif
```

## drivers/dma/Kconfig.fastvdma_litex
```kconfig
# Copyright 2021 Antmicro <www.antmicro.com>
# SPDX-License-Identifier: Apache-2.0

config DMA_LITEX_FASTVDMA
	bool
	prompt "LiteX FastVDMA driver"
	help
	  This option enables support of FastVDMA controller
	  integrated with LiteX SoC.
```

## drivers/eeprom/Kconfig.mb85rc
```kconfig
# Copyright (c) 2023 Antmicro <www.antmicro.com>
# SPDX-License-Identifier: Apache-2.0

config EEPROM_MB85RC
	bool "FUJITSU mb85rc i2c FRAM"
	default y
	depends on DT_HAS_FUJITSU_MB85RC_ENABLED
	select I2C
	help
	  Enable FUJITSU mb85rc i2c FRAM
```

## drivers/fpga/Kconfig
```kconfig
# FPGA driver configuration options

# Copyright (c) 2021 Antmicro <www.antmicro.com>
# SPDX-License-Identifier: Apache-2.0

menuconfig FPGA
	bool "FPGA Drivers"
	help
	  Enable support for FPGA drivers.

if FPGA

module = fpga

source "subsys/logging/Kconfig.template.log_config"

config FPGA_SHELL
	bool "Enable FPGA Shell"
	depends on SHELL && FPGA
	help
	  Enable FPGA Shell for testing.

source "drivers/fpga/Kconfig.eos_s3"

endif
```

## drivers/gpio/Kconfig.eos_s3
```kconfig
# EOS_S3 GPIO configuration options

# Copyright (c) 2020 Antmicro <www.antmicro.com>
# SPDX-License-Identifier: Apache-2.0

menuconfig GPIO_EOS_S3
	bool "EOS_S3 GPIO driver"
	depends on HAS_EOS_S3_HAL
	select HAS_DTS_GPIO
	help
	  Enable the EOS S3 gpio driver.
```

## drivers/gpio/Kconfig.pcf8574
```kconfig
# PCF8574 GPIO configuration options

# Copyright (c) 2021 Antmicro
# SPDX-License-Identifier: Apache-2.0

menuconfig GPIO_PCF8574
	bool "PCF8574 I2C-based GPIO chip"
	depends on I2C
	help
	  Enable driver for PCF8574 I2C-based GPIO chip.

config GPIO_PCF8574_INIT_PRIORITY
	int "Init priority"
	default 70
	depends on GPIO_PCF8574
	help
	  Device driver initialization priority.
```

## drivers/led/Kconfig.fomu_sbled
```kconfig
# Copyright (c) 2022 Antmicro
# SPDX-License-Identifier: Apache-2.0

config FOMU_SBLED
	bool "Fomu SBLED driver"
	help
	  Enable SBLED driver for Fomu.
```

## drivers/pwm/Kconfig.eos_s3
```kconfig
#
# Copyright (c) 2020 Antmicro <www.antmicro.com>
#
# SPDX-License-Identifier: Apache-2.0
#

menuconfig PWM_GEN_EOS_S3
	bool "EOS S3 PWM_GEN driver (FPGA IP core)"
	depends on SOC_EOS_S3
	depends on HAS_DTS
	select SOC_EOS_S3_FPGA
	help
	  Enable support for EOS S3 PWM_GEN driver

if PWM_EOS_S3

config PWM_GEN_EOS_S3_INIT_PRIORITY
	int "Init priority"
	default 70
	help
	  PWM device driver initialization priority.

endif # PWM_GEN_EOS_S3
```

## drivers/sensor/adxl345/Kconfig
```kconfig
#
# Copyright (c) 2019 Antmicro <www.antmicro.com>
#
# SPDX-License-Identifier: Apache-2.0
#

menuconfig ADXL345
	bool "ADXL345 Three Axis High-g I2C accelerometer"
	help
	  Enable driver for ADXL345 Three-Axis Digital Accelerometers.
```

## drivers/serial/Kconfig.fomu
```kconfig
# Copyright (c) 2022 Antmicro <www.antmicro.com>
# SPDX-License-Identifier: Apache-2.0

config UART_FOMU
	bool "Fomu serial driver"
	depends on SOC_RISCV32_KOSAGI_FOMU
	select SERIAL_HAS_DRIVER
	help
	  This option enables Fomu serial driver.
```

## drivers/serial/Kconfig.litex
```kconfig
# LiteX UART (LiteUART) configuration option

# Copyright (c) 2018 - 2019 Antmicro <www.antmicro.com>
# SPDX-License-Identifier: Apache-2.0

config UART_LITEUART
	bool "LiteUART serial driver"
	depends on SOC_RISCV32_LITEX_VEXRISCV || SOC_RISCV32_FOMU
	select SERIAL_HAS_DRIVER
	help
	  This option enables LiteUART serial driver.
```

## drivers/spi/Kconfig.eos_s3
```kconfig
# QuickLogic EOS S3 SPI

# Copyright (c) 2020 Antmicro <www.antmicro.com>
# SPDX-License-Identifier: Apache-2.0

config SPI_EOS_S3
	bool "QuickLogic EOS S3 SPI driver"
	default y
	depends on SOC_EOS_S3
	help
	  Enable support for the EOS S3 SPI driver.
```
